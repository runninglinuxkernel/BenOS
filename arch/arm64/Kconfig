## arch/arm64/Kconfig
```kconfig
config ARM64
	def_bool y
	help
	  ARM 64-bit (AArch64) support.

config 64BIT
	def_bool y

choice
	prompt "Uart for Pi"
	default PI_MINI_UART

config PI_MINI_UART
	bool "mini_uart"

config PI_PL_UART
	bool "pl_uart"
endchoice

#source "kernel/Kconfig"
source "init/Kconfig"
```

## drivers/irqchip/Kconfig
```kconfig
menu "Interrupt Controller"

config IRQCHIP
	def_bool y

choice
	prompt "interrupt chip for PI"
	default ARM_GICV2
	help
		ARM GIC V2 interrupt controller.

config ARM_GICV2
	bool "ARM GIC V2"
	depends on IRQCHIP
	depends on BOARD_PI4B

config PI_LEGACY_INTERRUPT
	bool "Legacy interrupt controller for PI"
	depends on IRQCHIP
	depends on BOARD_PI4B || BOARD_PI3B

endchoice
endmenu
```
